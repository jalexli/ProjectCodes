#include <SPI.h>
#include <Wire.h>
#include <Adafruit_GFX.h>
#include <Adafruit_SSD1306.h>

#define SCREEN_WIDTH 128 // OLED display width, in pixels
#define SCREEN_HEIGHT 64 // OLED display height, in pixels

#define OLED_RESET     4 // Reset pin # (or -1 if sharing Arduino reset pin)
#define SCREEN_ADDRESS 0x3D ///< See datasheet for Address; 0x3D for 128x64, 0x3C for 128x32
Adafruit_SSD1306 display(SCREEN_WIDTH, SCREEN_HEIGHT, &Wire, OLED_RESET);

#define imageWidth 128
#define imageHeight 64

const unsigned char bitmap [] PROGMEM= {
0x00, 0x00, 0x00, 0x00, 0x00, 0x00, 0x00, 0x00, 0x00, 0x00, 0x00, 0x00, 0x00, 0x00, 0x80, 0xC0,
0xC0, 0xC0, 0x80, 0x80, 0x80, 0x00, 0x00, 0x00, 0x00, 0x00, 0x00, 0x00, 0x00, 0x00, 0x00, 0x00,
0x00, 0x00, 0x00, 0x00, 0x00, 0x00, 0x00, 0x00, 0x00, 0x00, 0x00, 0x00, 0x00, 0x00, 0x00, 0x00,
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0x00, 0x00, 0x00, 0x00, 0x00, 0x00, 0x00, 0x00, 0x00, 0x00, 0x00, 0x00, 0x00, 0x00, 0x00, 0x00
};


////////////////////////////////////////////////////////////////////////
#include<Servo.h>
int trigPin = 3;
int echoPin = 2;

int trigPin2 = 7;
int echoPin2 = 6;

int dt = 10;
int pos = 90; //stores positon of servo
int distThresh = 10;
int handDistance = 0; //stores distance of hand
int handDistance2 = 0; //stores distance of hand
Servo servo;

int distance;
int duration;
int prevDist;

////////////////////////////////////////////////////////////////////////
//int distance,duration;
void setup() {

  pinMode(trigPin, OUTPUT);
  pinMode(echoPin, INPUT);
  pinMode(trigPin2, OUTPUT);
  pinMode(echoPin2, INPUT);
  ////////////////////////////////////////////
  Serial.begin(9600);
  servo.attach(9);
  servo.write(0);
  ////////////////////////////////////////////
  // SSD1306_SWITCHCAPVCC = generate display voltage from 3.3V internally
  if (!display.begin(SSD1306_SWITCHCAPVCC, SCREEN_ADDRESS)) {
    Serial.println(F("SSD1306 allocation failed"));
    for (;;); // Don't proceed, loop forever
  }
  // Show initial display buffer contents on the screen --
  // the library initializes this with an Adafruit splash screen.
  display.display();
  delay(2000); // Pause for 2 seconds

  // Clear the buffer
  display.clearDisplay();

  servo.write(90);
}
////////////////////////////////////////////////////////////////////////
//This code is written to calculate the DISTANCE using ULTRASONIC SENSOR

int calculateDist()
{

  // Clears the trigPin condition
  digitalWrite(trigPin, LOW);
  delayMicroseconds(2);
  // Sets the trigPin HIGH (ACTIVE) for 10 microseconds
  digitalWrite(trigPin, HIGH);
  delayMicroseconds(10);
  digitalWrite(trigPin, LOW);
  // Reads the echoPin, returns the sound wave travel time in microseconds
  duration = pulseIn(echoPin, HIGH);
  // Calculating the distance
  distance = duration * 0.034 / 2; // Speed of sound wave divided by 2 (go and back)
  // Displays the distance on the Serial Monitor
  Serial.print("Distance: ");
  Serial.print(distance);
  Serial.println(" cm");

  //deals with the weird readings caused by the servo motor
  //temp solution
  if (abs(prevDist - distance) >= 10) {
    return prevDist;
  }
  else {
    prevDist = distance;
  }
  return distance;
}

int calculateDist2()
{

  // Clears the trigPin condition
  digitalWrite(trigPin2, LOW);
  delayMicroseconds(2);
  // Sets the trigPin HIGH (ACTIVE) for 10 microseconds
  digitalWrite(trigPin2, HIGH);
  delayMicroseconds(10);
  digitalWrite(trigPin2, LOW);
  // Reads the echoPin, returns the sound wave travel time in microseconds
  duration = pulseIn(echoPin2, HIGH);
  // Calculating the distance
  distance = duration * 0.034 / 2; // Speed of sound wave divided by 2 (go and back)
  // Displays the distance on the Serial Monitor
  Serial.print("Distance2: ");
  Serial.print(distance);
  Serial.println(" cm");

  //deals with the weird readings caused by the servo motor
  //temp solution
  if (abs(prevDist - distance) >= 10) {
    return prevDist;
  }
  else {
    prevDist = distance;
  }
  return distance;
}

////////////////////////////////////////////////////////////////////////
void drawEyes(){
  display.fillCircle(64,32,30,WHITE);
  display.display();
}

////////////////////////////////////////////////////////////////////////

//needs work to account for all scenarios
void loop() {
  // put your main code here, to run repeatedly:
  handDistance = calculateDist();
  handDistance2 = calculateDist2();

  if (handDistance < distThresh  and pos == 90)
  {
    drawEyes();
    for (int i = 90; i <= 150; i++) {
      servo.write(i);
      delay(1);
      pos = 150;
    }
    delay(500);
  }
  else if (handDistance < distThresh and pos == 150) {

  }
  else if (handDistance > distThresh and pos == 150) {
    display.clearDisplay();
    display.display();
    for (int i = 150; i >= 90; i--) {
      servo.write(i);
      delay(1);
      pos = 90;
    }
    delay(500);
  }
  else if (handDistance > distThresh and pos == 90) {
  }


if (handDistance2 < distThresh  and pos == 90)
  {
    drawEyes();
    for (int i = 90; i >= 30; i--) {
      servo.write(i);
      delay(1);
      pos = 30;
    }
    delay(500);
  }
  else if (handDistance2 < distThresh and pos == 30) {

  }
  else if (handDistance2 > distThresh and pos == 30) {
    display.clearDisplay();
    display.display();
    for (int i = 30; i <= 90; i++) {
      servo.write(i);
      delay(1);
      pos = 90;
    }
    delay(500);
  }
  else if (handDistance2 > distThresh and pos == 90) {
  }
}
